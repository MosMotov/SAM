
#include <SoftwareSerial.h>
#include <Adafruit_NeoPixel.h>

SoftwareSerial mySerial(9, 10); // RX, TX
#define PIXEL_PIN    6
#define NUMPIXELS 16
Adafruit_NeoPixel pixels = Adafruit_NeoPixel(NUMPIXELS, PIXEL_PIN, NEO_GRB + NEO_KHZ800);

unsigned long pixelsInterval = 20; // the time we need to wait
unsigned long rainbowPreviousMillis = 0;
unsigned long rainbowCyclesPreviousMillis = 0;

int rainbowCycles = 0;
int rainbowCycleCycles = 0;


unsigned long measurePreviousMillis = 0;
int measure_pixel = 0;
int measure_frames = 100;
unsigned long measure_interval = 35;

unsigned long alarmPreviousMillis = 0;
int alarm_pixel = 0;
int alarm_frames = 100;
unsigned long alarm_interval = 20;

unsigned long whPreviousMillis = 0;
int wh_pixel = 0;
int wh_frames = 100;
unsigned long wh_interval = 35;

const byte taking_measurement[] PROGMEM = {68,148,137,60,129,124,38,94,93,19,54,60,3,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1,1};
const byte alarm[] PROGMEM = {0,0,0,1,0,0,0,0,0,0,1,0,1,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0,0};
const byte taking_wh[] PROGMEM = {26,101,0,27,99,0,22,88,1,14,58,0,9,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0,0};


int currentPixel = 0;
int cmd;


void setup() {
  // Open serial communications and wait for port to open:
  Serial.begin(115200);

  // set the data rate for the SoftwareSerial port
  mySerial.begin(9600);

  currentPixel = 0;
  pixels.begin();
  pixels.show();
}

void loop() { // run over and over
  if (mySerial.available()) {
    cmd = int(mySerial.read());
    Serial.println(cmd);
  }
  if (cmd == 97) {
    if ((unsigned long)(millis() - measurePreviousMillis) >= measure_interval) {
      measurePreviousMillis = millis();
      pattern(taking_measurement, measure_pixel, measure_frames);
    }
  }
  else if (cmd == 98) {
    if ((unsigned long)(millis() - alarmPreviousMillis) >= alarm_interval) {
      alarmPreviousMillis = millis();
      pattern(alarm, alarm_pixel, alarm_frames);
    }
  }
  else if (cmd == 99) {
    if ((unsigned long)(millis() - whPreviousMillis) >= wh_interval) {
      whPreviousMillis = millis();
      pattern(taking_wh, wh_pixel, wh_frames);
    }
  }

}

void pattern(byte data[], int &pattern_pixel, int frames) {
  for (int i = 0; i < NUMPIXELS; i++) {
    int pixelIndex = i % NUMPIXELS;
    int index = pattern_pixel * NUMPIXELS * 3 + pixelIndex * 3;

    //Note: We're using pgm_read_byte_near to read bytes out of the data array stored in PROGMEM. These functions are not required for all configurations
    pixels.setPixelColor(i, pgm_read_byte_near(data + index), pgm_read_byte_near(data + index + 1), pgm_read_byte_near(data + index + 2));
  }
  pixels.show();
  pattern_pixel ++;
  if (pattern_pixel >= frames) pattern_pixel = 0;
}

void rainbow() {
  for (uint16_t i = 0; i < pixels.numPixels(); i++) {
    pixels.setPixelColor(i, Wheel((i + rainbowCycles) & 255));
  }
  pixels.show();
  rainbowCycles++;
  if (rainbowCycles >= 256) rainbowCycles = 0;
}

// Slightly different, this makes the rainbow equally distributed throughout
void rainbowCycle() {
  uint16_t i;

  //for(j=0; j<256*5; j++) { // 5 cycles of all colors on wheel
  for (i = 0; i < pixels.numPixels(); i++) {
    pixels.setPixelColor(i, Wheel(((i * 256 / pixels.numPixels()) + rainbowCycleCycles) & 255));
  }
  pixels.show();

  rainbowCycleCycles++;
  if (rainbowCycleCycles >= 256 * 5) rainbowCycleCycles = 0;
}

// Input a value 0 to 255 to get a color value.
// The colours are a transition r - g - b - back to r.
uint32_t Wheel(byte WheelPos) {
  WheelPos = 255 - WheelPos;
  if (WheelPos < 85) {
    return pixels.Color(255 - WheelPos * 3, 0, WheelPos * 3);
  }
  if (WheelPos < 170) {
    WheelPos -= 85;
    return pixels.Color(0, WheelPos * 3, 255 - WheelPos * 3);
  }
  WheelPos -= 170;
  return pixels.Color(WheelPos * 3, 255 - WheelPos * 3, 0);
}


